## images/apple-vf/buildroot/configs/agency_apple_vf_aarch64_defconfig
```kconfig
BR2_aarch64=y
BR2_TOOLCHAIN_BUILDROOT_MUSL=y
BR2_PACKAGE_HOST_LINUX_HEADERS_CUSTOM_6_12=y
BR2_LINUX_KERNEL=y
BR2_LINUX_KERNEL_CUSTOM_VERSION=y
BR2_LINUX_KERNEL_CUSTOM_VERSION_VALUE="6.12.22"
BR2_LINUX_KERNEL_USE_CUSTOM_CONFIG=y
BR2_LINUX_KERNEL_CUSTOM_CONFIG_FILE="$(BR2_EXTERNAL_AGENCY_PATH)/board/agency/apple-vf/linux.config"
BR2_LINUX_KERNEL_IMAGE=y
# Buildroot is used here only to produce a pinned ARM64 Linux kernel for
# Apple Virtualization.framework. Rootfs artifacts must come from Agency's
# OCI image realization path, shared with Firecracker where possible.
BR2_INIT_NONE=y
BR2_PACKAGE_BUSYBOX=n
BR2_TARGET_ROOTFS_TAR=n
```

## images/firecracker/buildroot/configs/agency_firecracker_x86_64_defconfig
```kconfig
BR2_x86_64=y
BR2_TOOLCHAIN_BUILDROOT_MUSL=y
BR2_PACKAGE_HOST_LINUX_HEADERS_CUSTOM_6_12=y
BR2_LINUX_KERNEL=y
BR2_LINUX_KERNEL_CUSTOM_VERSION=y
BR2_LINUX_KERNEL_CUSTOM_VERSION_VALUE="6.12.22"
BR2_LINUX_KERNEL_USE_CUSTOM_CONFIG=y
BR2_LINUX_KERNEL_CUSTOM_CONFIG_FILE="$(BR2_EXTERNAL_AGENCY_FIRECRACKER_PATH)/board/agency/firecracker/linux-x86_64.config"
BR2_LINUX_KERNEL_VMLINUX=y
BR2_LINUX_KERNEL_NEEDS_HOST_LIBELF=y
# Buildroot is used here only to produce a pinned x86_64 Linux vmlinux for
# Firecracker. Rootfs artifacts must come from Agency's OCI image realization
# path, shared with Apple VF where possible.
BR2_INIT_NONE=y
BR2_PACKAGE_BUSYBOX=n
BR2_TARGET_ROOTFS_TAR=n
```
